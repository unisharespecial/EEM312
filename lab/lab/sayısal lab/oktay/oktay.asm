
LIST p=16F84A
INCLUDE "P16F84A.inc"

__CONFIG  _CP_OFF &_WDT_OFF &_PWRTE_ON &_RC_OSC

ORG 0X00

S1 EQU H'21'
S2 EQU H'22'
S3 EQU H'23'
CNTR EQU H'24'

BASLA
	CLRF	PORTB
	CLRF 	CNTR
	BSF 	STATUS,5
	CLRF	TRISB
	BCF 	STATUS,5
SHOW
	MOVLW	B'00100000'
	MOVWF	PORTB
	CALL	DLY
	
	MOVLW	B'00010000'
	MOVWF	PORTB
	CALL	DLY	
	
	MOVLW	B'10000000'
	MOVWF	PORTB
	CALL	DLY

	MOVLW	B'00000001'
	MOVWF	PORTB
	CALL	DLY

	MOVLW	B'00000010'
	MOVWF	PORTB
	CALL	DLY

	MOVLW	B'00000100'
	MOVWF	PORTB
	CALL    DLY 
	
	MOVLW	B'10000000'
	MOVWF	PORTB
	CALL	DLY

	MOVLW	B'01000000'
	MOVWF	PORTB
	CALL	DLY

	GOTO 	SHOW


DLY
	MOVLW	D'5'
	MOVWF	S1
L1
	MOVLW	D'250'
	MOVWF	S2
L2
	MOVLW 	D'250'
	MOVWF	S3
L3
	DECFSZ	S3,F
	GOTO	L3
	DECFSZ 	S2,F
	GOTO	L2
	DECFSZ	S1,F
	GOTO	L1
RETURN
END
